/dts-v1/;

/ {
    model = "PocketDarwin Boot Config";
    compatible = "pocketdarwin,boot";

    boot-options {
        option0 = "Boot Darwin from partition 1";
        option1 = "Boot from image.raw";
    };

    framebuffer {
        base = <0x80000000>;
        width = <1080>;
        height = <1920>;
        pitch = <4320>;
        bpp = <32>;
    };

    gpio-keys {
        vol-up = <115>;
        vol-down = <114>;
        power = <116>;
    };
};
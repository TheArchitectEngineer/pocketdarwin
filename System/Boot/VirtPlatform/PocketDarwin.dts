/dts-v1/;

/ {
    compatible = "pocketdarwin,virtual-platform";
    #address-cells = <2>;
    #size-cells = <2>;

    memory@40000000 {
        device_type = "memory";
        reg = <0x0 0x40000000  0x0 0x40000000>; // base, size (example 1GB)
    };

    cpus {
        #address-cells = <1>;
        #size-cells = <0>;

        cpu@0 {
            device_type = "cpu";
            compatible = "arm,armv8";
            reg = <0>;
        };
    };
};
